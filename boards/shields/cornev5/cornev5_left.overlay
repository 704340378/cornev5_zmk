#include "cornev5.dtsi"

/ {
    chosen {
        zmk,split = <&split0>;
    };

    split0: split {
        compatible = "zmk,split";
        role = "central";
    };
};

&default_transform {
    col-offset = <0>;   // ✅ 左半边偏移 0
};
