#include "cornev5.dtsi"

/ {
    chosen {
        zmk,split = <&split1>;
    };

    split1: split {
        compatible = "zmk,split";
        role = "peripheral";
    };
};

&default_transform {
    col-offset = <6>;   // ✅ 右半边偏移 6
};
