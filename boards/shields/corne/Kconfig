## boards/shields/corne/Kconfig
```kconfig
# Copyright (c) 2020 The ZMK Contributors
# SPDX-License-Identifier: MIT

config SHIELD_CORNEV5_LEFT
    def_bool $(shields_list_contains,corne_left)

config SHIELD_CORNEV5_RIGHT
    def_bool $(shields_list_contains,corne_right)
```

## boards/shields/corne/Kconfig.defconfig
```kconfig
# boards/shields/cornev5/Kconfig.defconfig

if SHIELD_CORNEV5_LEFT
    config ZMK_KEYBOARD_NAME
        default "Corne v5 Left"
    config ZMK_SPLIT_ROLE_CENTRAL
        default y
endif

if SHIELD_CORNEV5_RIGHT
    config ZMK_KEYBOARD_NAME
        default "Corne v5 Right"
endif

if SHIELD_CORNEV5_LEFT || SHIELD_CORNEV5_RIGHT
    config ZMK_SPLIT
        default y
endif
```

## boards/shields/cornev5/Kconfig
```kconfig
#
# Copyright (c) 2022 The ZMK Contributors
# SPDX-License-Identifier: MIT
#

config SHIELD_CORNEV5_LEFT
    bool

config SHIELD_CORNEV5_RIGHT
    bool
```

## boards/shields/cornev5/Kconfig.defconfig
```kconfig
# Kconfig.defconfig
if SHIELD_CORNEV5_LEFT
    config ZMK_KEYBOARD_NAME
        default "CorneV5 Left"
endif

if SHIELD_CORNEV5_RIGHT
    config ZMK_KEYBOARD_NAME
        default "CorneV5 Right"
endif
```
